#include <LiquidCrystal.h>
LiquidCrystal lcd(8, 9, 4, 5, 6, 7);        // для работы дисплея

int h;             // для часов
int m;             //   для минут
int s;             //      для секунд

void setup() {
  lcd.begin(16, 2);
  lcd.backlight(0);
  lcd.print ("EASY AMPER show");
  delay(400);
  lcd.setCursor(0, 1);
  lcd.print ("clock no RTC");         // заставка в начале работы
  delay(3400);
  lcd.clear();
}

void loop() {
  int k =  analogRead(A0);            // приравниваем переменную
  //  к значению с пина A0
  s = s + 1;              // Счёт секунд

  /////////////////////////////////////////////////////////////
  if (s == 60) {              // блок счёта времени
    s = 0;                    // в 1ой минуте 60 сек
    m = m + 1;
    lcd.clear();
  }
  if (m == 60) {              // в 1ом часе 60 минут
    m = 0;
    h = h + 1;
  }
  if (h == 24) {             // день в среднем равен 24 часа
    h = 0;
    m = 0;                   // сброс счётчика , можно добавить
    s = 0;                   //   счёт дней, добавив переменную
  }
  /////////////////////////////////////////////////////////////
  // блок настройки времени
  if (k >= 0 && k < 100) {
    m = m + 1  ;               // RIGHT
    if (m >= 60) {
      m = 0;
      lcd.clear();
    }
  }
  if (k >= 100 && k < 200) {
    m = m + 10;               // UP
    if (m >= 60) {
      m = 0;
      lcd.clear();
    }
  }
  if (k >= 200 && k < 400) {
    m = m + 30;              // DOWN
    if (m >= 60) {
      m = 0;
      lcd.clear();
    }
  }
  if (k >= 400 && k < 600) {
    h = h + 10;              // LEFT
    if (h >= 24) {           // защита от перебора значения(во всех)
      h = 0;
      lcd.clear();
    }
  }
  if (k >= 600 && k < 800) {
    h = h + 1;               // SELECT
    if (h >= 24) {
      h = 0;
      lcd.clear();           // очищаем для удаления возможных старых значений
    }
  }
  /////////////////////////////////////////////////////////////
  // блок вывода времени на дисплей
  lcd.setCursor(3, 0);       // установка курсора
  lcd.print (h);             // вывод часов
  lcd.print (" : ");         // вывод разделителя
  lcd.print (m);             // вывод минут
  lcd.print (" : ");         // вывод разделителя
  lcd.print (s);             // вывод секунд

  lcd.setCursor(0, 1);
  if (s == 5) {
    lcd.print ("|");
  }
  if (s == 10) {
    lcd.print ("||");
  }
  if (s == 15) {
    lcd.print ("|||");
  }
  if (s == 20) {
    lcd.print ("||||");
  }
  if (s == 25) {
    lcd.print ("|||||");
  }
  if (s == 30) {
    lcd.print ("||||||");
  }
  if (s == 35) {
    lcd.print ("||||||||");
  }
  if (s == 40) {
    lcd.print ("||||||||||");
  }
  if (s == 45) {
    lcd.print ("|||||||||||");
  }
  if (s == 50) {
    lcd.print ("|||||||||||||");
  }
  if (s == 55) {
    lcd.print ("||||||||||||||");
  }
  if (s == 58) {
    lcd.print ("||||||||||||||||");
  }
  /////////////////////////////////////////////////////////////

  delay(1000);              // пауза 1 секунда (для исчисления времени)
}
